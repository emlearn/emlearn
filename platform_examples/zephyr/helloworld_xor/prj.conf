## CMakeLists.txt
```
cmake_minimum_required(VERSION 3.20.0)

find_package(Zephyr REQUIRED HINTS $ENV{ZEPHYR_BASE})
project(emlearn_hello_world)

file(GLOB app_sources src/*)
target_sources(app PRIVATE ${app_sources})
```

## west.yml
```
# Copyright (c) 2021 Nordic Semiconductor ASA
# SPDX-License-Identifier: Apache-2.0

manifest:
  remotes:
    - name: zephyrproject-rtos
      url-base: https://github.com/zephyrproject-rtos

  projects:
    - name: zephyr
      remote: zephyrproject-rtos
      revision: v4.2.1
      import:
        # By using name-allowlist we can clone only the modules that are strictly needed
        name-allowlist:
          - cmsis_6      # required by the ARM port
          - hal_nordic # required by the qemu cortex board (Nordic based)

    - name: emlearn
      url: https://github.com/emlearn/emlearn
      revision: master
```

## prj.conf
```kconfig
# enable the emlearn module
CONFIG_EMLEARN=y
```

## src/main.c
```c
/*
 * emlearn example for Zephyr RTOS
 */

#include <zephyr/kernel.h>

#include "xor_model.h"

void xor_test(void)
{
    const int16_t test_inputs[4][2] = {
        { 0,    0   },
        { 255,  0   },
        { 0,    255 },
        { 255,  255 },
    };

    for (int i=0; i<4; i++) {
        const int16_t *features = test_inputs[i];
        const int out = xor_model_predict(features, 2);

        printf("xor(%d,%d) = %d\n", (int)features[0], (int)features[1], out);
    }
}

int main(void)
{
    xor_test();
    return 0;
}
```
